&pointing_device {
    status = "okay";
};
&pointing_listener {
    status = "okay";
    device = <&pointing_device>;

    input-processors = 
        <&zip_xy_transform (INPUT_TRANSFORM_X_INVERT | INPUT_TRANSFORM_Y_INVERT)>, 
        <&zip_temp_layer 1 640>;

    fast_cursor {
        layers = <2>;
        input-processors = 
            <&zip_xy_transform (INPUT_TRANSFORM_X_INVERT | INPUT_TRANSFORM_Y_INVERT)>, 
            <&zip_xy_scaler 2 1>,
            <&zip_temp_layer 1 640>;
    };
    
    scroller {
        layers = <3>;
        input-processors = 
            <&zip_xy_to_scroll_mapper>, 
            <&zip_scroll_transform (INPUT_TRANSFORM_X_INVERT)>, 
            <&zip_scroll_scaler 1 4>;
    };
};
